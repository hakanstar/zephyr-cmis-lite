## tests/cmis_core/testcase.yaml
```yaml
tests:
  cmis_core.unit:
    tags: cmis
    platform_allow:
      - native_sim
    integration_platforms:
      - native_sim
```

## west.yml
```yaml
# SPDX-License-Identifier: Apache-2.0
manifest:
  remotes:
    - name: zephyrproject-rtos
      url-base: https://github.com/zephyrproject-rtos

  projects:
    - name: zephyr
      remote: zephyrproject-rtos
      revision: v4.5.0
      import:
        # Only the modules this project needs
        name-allowlist:
          - cmsis      # Cortex-M support
          - cmsis_6    # Cortex-M support (CMSIS 6)
          - hal_stm32  # NUCLEO-F411RE
```
