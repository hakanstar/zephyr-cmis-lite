## CMakeLists.txt
```
# SPDX-License-Identifier: Apache-2.0
cmake_minimum_required(VERSION 3.20.0)
find_package(Zephyr REQUIRED HINTS $ENV{ZEPHYR_BASE})
project(zephyr_cmis_lite)

set(CMIS_CORE_DIR ${CMAKE_CURRENT_SOURCE_DIR}/../lib/cmis_core)

target_sources(app PRIVATE
  src/main.c
  src/module.c
  src/i2c_target.c
  src/sensor.c
  src/shell_cmds.c
  ${CMIS_CORE_DIR}/src/cmis_core.c
)
target_include_directories(app PRIVATE ${CMIS_CORE_DIR}/include)
```

## sample.yaml
```
sample:
  name: CMIS-lite module firmware
common:
  tags: cmis
tests:
  app.cmis_lite.build:
    build_only: true
    platform_allow:
      - nucleo_f411re
    integration_platforms:
      - nucleo_f411re
```

## prj.conf
```kconfig
CONFIG_LOG=y
CONFIG_I2C=y
CONFIG_I2C_TARGET=y
CONFIG_I2C_STM32_INTERRUPT=y
CONFIG_ADC=y
CONFIG_SENSOR=y
CONFIG_SHELL=y
```

## boards/nucleo_f411re.overlay
```dts
/*
 * SPDX-License-Identifier: Apache-2.0
 *
 * On-chip monitors: die temperature sensor and internal reference
 * voltage (VREFINT, used to compute VDDA), both on ADC1.
 * ADCCLK = APB2 (84 MHz) / 4 = 21 MHz, within the 36 MHz limit.
 */
&adc123_common {
	st,adc-prescaler = <4>;
	status = "okay";
};

&adc1 {
	status = "okay";
};

&die_temp {
	status = "okay";
};

&vref {
	status = "okay";
};
```

## src/main.c
```c
/*
 * SPDX-License-Identifier: Apache-2.0
 *
 * zephyr-cmis-lite: CMIS-inspired I2C module management firmware
 */
#include <zephyr/kernel.h>
#include <zephyr/logging/log.h>

#include "module.h"

LOG_MODULE_REGISTER(app, LOG_LEVEL_INF);

#define HEARTBEAT_PERIOD K_SECONDS(30) /* use 'cmis status' for on-demand values */

int main(void)
{
	uint32_t tick = 0;

	LOG_INF("cmis-lite booting on %s", CONFIG_BOARD_TARGET);

	module_init();
	if (module_i2c_target_init() != 0) {
		LOG_ERR("running without I2C target");
	}

	while (true) {
		int16_t temp_q8;
		uint16_t vcc;
		uint8_t flags;

		module_get_monitors(&temp_q8, &vcc, &flags);
		/* temp_q8 / 256 = degC; print with one decimal using integers only */
		int32_t t10 = ((int32_t)temp_q8 * 10) / 256;

		LOG_INF("hb %u, state %s, temp %d.%d C, vcc %u.%04u V, flags 0x%02x",
			tick++, module_state_name(module_get_state()),
			t10 / 10, (t10 < 0 ? -t10 : t10) % 10,
			vcc / 10000U, vcc % 10000U, flags);
		k_sleep(HEARTBEAT_PERIOD);
	}

	return 0;
}
```

## src/i2c_target.c
```c
/*
 * SPDX-License-Identifier: Apache-2.0
 *
 * I2C target front end: maps byte-level I2C callbacks onto the core.
 * Protocol: first written byte = register address, then data bytes with
 * auto-increment. A read returns bytes from the current register address.
 *
 * Callbacks run in ISR context: no logging, no blocking, short critical
 * sections only. Control writes are handed to the command thread.
 */
#include <zephyr/device.h>
#include <zephyr/drivers/i2c.h>
#include <zephyr/kernel.h>
#include <zephyr/logging/log.h>

#include "module.h"

LOG_MODULE_REGISTER(cmis_i2c, LOG_LEVEL_INF);

#define CMIS_I2C_ADDR 0x50

static const struct device *const i2c_dev = DEVICE_DT_GET(DT_NODELABEL(i2c1));

static uint8_t reg_addr;
static bool addr_phase;
static bool ctrl_written;

static int on_write_requested(struct i2c_target_config *cfg)
{
	ARG_UNUSED(cfg);
	addr_phase = true;
	return 0;
}

static int on_write_received(struct i2c_target_config *cfg, uint8_t val)
{
	k_spinlock_key_t key;

	ARG_UNUSED(cfg);

	if (addr_phase) {
		reg_addr = val;
		addr_phase = false;
		return 0;
	}

	key = k_spin_lock(&module_lock);
	(void)cmis_write(&module_ctx, reg_addr, val); /* writes to RO bytes are ignored */
	k_spin_unlock(&module_lock, key);

	if (reg_addr == CMIS_REG_MODULE_CTRL) {
		ctrl_written = true;
	}
	reg_addr++;
	return 0;
}

static int on_read_requested(struct i2c_target_config *cfg, uint8_t *val)
{
	k_spinlock_key_t key;

	ARG_UNUSED(cfg);

	/* First byte of a read: this one reaches the host, so side effects apply */
	key = k_spin_lock(&module_lock);
	*val = cmis_read(&module_ctx, reg_addr);
	k_spin_unlock(&module_lock, key);
	return 0;
}

static int on_read_processed(struct i2c_target_config *cfg, uint8_t *val)
{
	k_spinlock_key_t key;

	ARG_UNUSED(cfg);

	/*
	 * The driver may prefetch a byte the host never clocks out, so use
	 * the side-effect-free peek. Clear-on-read therefore applies only
	 * when 0x08 is the first byte of a read transaction.
	 */
	reg_addr++;
	key = k_spin_lock(&module_lock);
	*val = cmis_peek(&module_ctx, reg_addr);
	k_spin_unlock(&module_lock, key);
	return 0;
}

static int on_stop(struct i2c_target_config *cfg)
{
	ARG_UNUSED(cfg);

	addr_phase = false;
	if (ctrl_written) {
		ctrl_written = false;
		module_request_process();
	}
	return 0;
}

static const struct i2c_target_callbacks target_callbacks = {
	.write_requested = on_write_requested,
	.write_received = on_write_received,
	.read_requested = on_read_requested,
	.read_processed = on_read_processed,
	.stop = on_stop,
};

static struct i2c_target_config target_cfg = {
	.address = CMIS_I2C_ADDR,
	.callbacks = &target_callbacks,
};

int module_i2c_target_init(void)
{
	int ret;

	if (!device_is_ready(i2c_dev)) {
		LOG_ERR("I2C device not ready");
		return -ENODEV;
	}

	ret = i2c_target_register(i2c_dev, &target_cfg);
	if (ret != 0) {
		LOG_ERR("i2c_target_register failed: %d", ret);
		return ret;
	}

	LOG_INF("I2C target at 0x%02x on %s", CMIS_I2C_ADDR, i2c_dev->name);
	return 0;
}
```

## src/module.c
```c
/*
 * SPDX-License-Identifier: Apache-2.0
 */
#include <zephyr/kernel.h>
#include <zephyr/logging/log.h>

#include "module.h"

LOG_MODULE_REGISTER(module, LOG_LEVEL_INF);

#define MODULE_CMD_PROCESS   1U
#define TRANSITION_DELAY_MS  50

struct cmis_ctx module_ctx;
struct k_spinlock module_lock;

K_MSGQ_DEFINE(module_cmd_q, sizeof(uint8_t), 8, 1);

static const struct cmis_identity module_id = {
	.vendor = "STAR LABS",
	.part_number = "CMIS-LITE-01",
	.serial = "SN0001",
};

const char *module_state_name(enum cmis_state state)
{
	switch (state) {
	case CMIS_STATE_RESET:
		return "RESET";
	case CMIS_STATE_LOW_PWR:
		return "LOW_PWR";
	case CMIS_STATE_PWR_UP:
		return "PWR_UP";
	case CMIS_STATE_READY:
		return "READY";
	case CMIS_STATE_FAULT:
		return "FAULT";
	default:
		return "?";
	}
}

enum cmis_state module_get_state(void)
{
	k_spinlock_key_t key = k_spin_lock(&module_lock);
	enum cmis_state state = cmis_get_state(&module_ctx);

	k_spin_unlock(&module_lock, key);
	return state;
}

void module_update_monitors(int16_t temp_q8, uint16_t vcc_100uv)
{
	k_spinlock_key_t key = k_spin_lock(&module_lock);

	cmis_set_monitors(&module_ctx, temp_q8, vcc_100uv);
	k_spin_unlock(&module_lock, key);
}

void module_set_fault(bool fault)
{
	k_spinlock_key_t key = k_spin_lock(&module_lock);
	bool changed = (module_ctx.fault != fault);

	cmis_set_fault(&module_ctx, fault);
	k_spin_unlock(&module_lock, key);

	if (changed) {
		LOG_WRN("sensor fault %s", fault ? "set" : "cleared");
		module_request_process();
	}
}

void module_get_monitors(int16_t *temp_q8, uint16_t *vcc_100uv, uint8_t *flags)
{
	k_spinlock_key_t key = k_spin_lock(&module_lock);

	*temp_q8 = (int16_t)((cmis_peek(&module_ctx, CMIS_REG_TEMP_MSB) << 8) |
			     cmis_peek(&module_ctx, CMIS_REG_TEMP_LSB));
	*vcc_100uv = (uint16_t)((cmis_peek(&module_ctx, CMIS_REG_VCC_MSB) << 8) |
				cmis_peek(&module_ctx, CMIS_REG_VCC_LSB));
	*flags = cmis_peek(&module_ctx, CMIS_REG_LATCHED_FLAGS);
	k_spin_unlock(&module_lock, key);
}

static bool is_transitional(enum cmis_state state)
{
	return state == CMIS_STATE_RESET || state == CMIS_STATE_PWR_UP;
}

static void run_state_machine(void)
{
	enum cmis_state prev = module_get_state();
	enum cmis_state state;

	do {
		k_spinlock_key_t key = k_spin_lock(&module_lock);

		cmis_process(&module_ctx);
		state = cmis_get_state(&module_ctx);
		k_spin_unlock(&module_lock, key);

		if (state != prev) {
			LOG_INF("state %s -> %s", module_state_name(prev),
				module_state_name(state));
			prev = state;
		}
		if (is_transitional(state)) {
			/* Stand-in for real power-up time */
			k_msleep(TRANSITION_DELAY_MS);
		}
	} while (is_transitional(state));
}

static void cmd_thread(void *p1, void *p2, void *p3)
{
	uint8_t cmd;

	ARG_UNUSED(p1);
	ARG_UNUSED(p2);
	ARG_UNUSED(p3);

	while (true) {
		k_msgq_get(&module_cmd_q, &cmd, K_FOREVER);
		if (cmd == MODULE_CMD_PROCESS) {
			run_state_machine();
		}
	}
}

K_THREAD_DEFINE(module_cmd_tid, 1024, cmd_thread, NULL, NULL, NULL, 5, 0, 0);

void module_request_process(void)
{
	uint8_t cmd = MODULE_CMD_PROCESS;

	/* K_NO_WAIT keeps this ISR-safe; if the queue is full a run is pending anyway */
	(void)k_msgq_put(&module_cmd_q, &cmd, K_NO_WAIT);
}

void module_init(void)
{
	k_spinlock_key_t key = k_spin_lock(&module_lock);

	(void)cmis_init(&module_ctx, &module_id);
	k_spin_unlock(&module_lock, key);

	module_request_process(); /* RESET -> LOW_PWR */
}
```

## src/module.h
```c
/*
 * SPDX-License-Identifier: Apache-2.0
 *
 * Shared module context. The core is touched from I2C target callbacks,
 * which run in ISR context, so it is guarded by a spinlock (a k_mutex
 * cannot be taken from an ISR).
 */
#ifndef APP_MODULE_H_
#define APP_MODULE_H_

#include <zephyr/spinlock.h>

#include "cmis_core.h"

extern struct cmis_ctx module_ctx;
extern struct k_spinlock module_lock;

/* Load defaults and leave RESET. Call once from main. */
void module_init(void);

/* Ask the command thread to run the state machine. ISR-safe. */
void module_request_process(void);

enum cmis_state module_get_state(void);

/* Push a new sensor sample into the core (thread context). */
void module_update_monitors(int16_t temp_q8, uint16_t vcc_100uv);

/* Report sensor health; a fault moves the module to FAULT. */
void module_set_fault(bool fault);

/* Snapshot of the monitor registers for logging (no side effects). */
void module_get_monitors(int16_t *temp_q8, uint16_t *vcc_100uv, uint8_t *flags);
const char *module_state_name(enum cmis_state state);

/* Force a simulated sensor failure (defined in sensor.c). */
void sensor_inject_fault(bool on);
bool sensor_fault_injected(void);

/* Register the I2C target (defined in i2c_target.c). */
int module_i2c_target_init(void);

#endif /* APP_MODULE_H_ */
```

## src/sensor.c
```c
/*
 * SPDX-License-Identifier: Apache-2.0
 *
 * Sensor thread: samples the MCU die temperature and VDDA (via VREFINT)
 * once per second and feeds them into the core's monitor registers.
 * A failed read reports a sensor fault to the module.
 */
#include <zephyr/device.h>
#include <zephyr/drivers/sensor.h>
#include <zephyr/kernel.h>
#include <zephyr/logging/log.h>
#include <zephyr/sys/atomic.h>

#include "module.h"

LOG_MODULE_REGISTER(sensor, LOG_LEVEL_INF);

#define SAMPLE_PERIOD K_SECONDS(1)

static atomic_t fault_injected;

void sensor_inject_fault(bool on)
{
	atomic_set(&fault_injected, on ? 1 : 0);
}

bool sensor_fault_injected(void)
{
	return atomic_get(&fault_injected) != 0;
}

static const struct device *const temp_dev = DEVICE_DT_GET(DT_NODELABEL(die_temp));
static const struct device *const vref_dev = DEVICE_DT_GET(DT_NODELABEL(vref));

/* Celsius as sensor_value -> 1/256 C (CMIS-style s16) */
static int16_t to_temp_q8(const struct sensor_value *v)
{
	int64_t micro = (int64_t)v->val1 * 1000000 + v->val2;

	return (int16_t)((micro * 256) / 1000000);
}

/* Volts as sensor_value -> 100 uV units */
static uint16_t to_vcc_100uv(const struct sensor_value *v)
{
	int64_t micro = (int64_t)v->val1 * 1000000 + v->val2;

	if (micro < 0) {
		return 0;
	}
	return (uint16_t)(micro / 100);
}

static int read_channel(const struct device *dev, enum sensor_channel chan,
			struct sensor_value *out)
{
	int ret = sensor_sample_fetch(dev);

	if (ret == 0) {
		ret = sensor_channel_get(dev, chan, out);
	}
	return ret;
}

static void sensor_thread(void *p1, void *p2, void *p3)
{
	struct sensor_value temp;
	struct sensor_value vcc;

	ARG_UNUSED(p1);
	ARG_UNUSED(p2);
	ARG_UNUSED(p3);

	if (!device_is_ready(temp_dev) || !device_is_ready(vref_dev)) {
		LOG_ERR("on-chip sensors not ready");
		module_set_fault(true);
		return;
	}

	while (true) {
		int ret_t = read_channel(temp_dev, SENSOR_CHAN_DIE_TEMP, &temp);
		int ret_v = read_channel(vref_dev, SENSOR_CHAN_VOLTAGE, &vcc);

		if (sensor_fault_injected()) {
			module_set_fault(true);
		} else if (ret_t != 0 || ret_v != 0) {
			LOG_ERR("sensor read failed (temp %d, vref %d)", ret_t, ret_v);
			module_set_fault(true);
		} else {
			module_update_monitors(to_temp_q8(&temp), to_vcc_100uv(&vcc));
			module_set_fault(false); /* FAULT state itself needs a SW reset */
		}
		k_sleep(SAMPLE_PERIOD);
	}
}

K_THREAD_DEFINE(sensor_tid, 1024, sensor_thread, NULL, NULL, NULL, 7, 0, 0);
```

## src/shell_cmds.c
```c
/*
 * SPDX-License-Identifier: Apache-2.0
 *
 * Zephyr shell commands for inspecting and driving the module locally:
 *   cmis status | dump [lower|p00|p02] | read <addr> | write <addr> <val>
 *   cmis lowpwr <on|off> | reset | fault <on|off>
 * Reads use cmis_peek(), so the shell never clears latched flags.
 */
#include <stdlib.h>
#include <string.h>

#include <zephyr/kernel.h>
#include <zephyr/shell/shell.h>

#include "module.h"

static int parse_u8(const struct shell *sh, const char *arg, uint8_t *out)
{
	char *end;
	unsigned long v = strtoul(arg, &end, 0);

	if (*arg == '\0' || *end != '\0' || v > 0xFFUL) {
		shell_error(sh, "invalid byte value: %s", arg);
		return -EINVAL;
	}
	*out = (uint8_t)v;
	return 0;
}

static int parse_on_off(const struct shell *sh, const char *arg, bool *out)
{
	if (strcmp(arg, "on") == 0) {
		*out = true;
	} else if (strcmp(arg, "off") == 0) {
		*out = false;
	} else {
		shell_error(sh, "expected on|off");
		return -EINVAL;
	}
	return 0;
}

static int host_write(const struct shell *sh, uint8_t addr, uint8_t val)
{
	k_spinlock_key_t key = k_spin_lock(&module_lock);
	int ret = cmis_write(&module_ctx, addr, val);

	k_spin_unlock(&module_lock, key);

	if (ret != CMIS_OK) {
		shell_error(sh, "write 0x%02x <- 0x%02x rejected (%d)", addr, val, ret);
		return -EACCES;
	}
	if (addr == CMIS_REG_MODULE_CTRL) {
		module_request_process();
	}
	return 0;
}

static int cmd_status(const struct shell *sh, size_t argc, char **argv)
{
	int16_t temp_q8;
	uint16_t vcc;
	uint8_t flags;
	uint8_t state_reg;
	uint8_t ctrl;
	uint8_t page;
	k_spinlock_key_t key;

	ARG_UNUSED(argc);
	ARG_UNUSED(argv);

	module_get_monitors(&temp_q8, &vcc, &flags);
	key = k_spin_lock(&module_lock);
	state_reg = cmis_peek(&module_ctx, CMIS_REG_MODULE_STATE);
	ctrl = cmis_peek(&module_ctx, CMIS_REG_MODULE_CTRL);
	page = cmis_peek(&module_ctx, CMIS_REG_PAGE_SELECT);
	k_spin_unlock(&module_lock, key);

	int32_t t10 = ((int32_t)temp_q8 * 10) / 256;

	shell_print(sh, "state       : %s (reg 0x03 = 0x%02x, IntL %s)",
		    module_state_name(module_get_state()), state_reg,
		    (state_reg & CMIS_INTL_DEASSERTED) ? "deasserted" : "ASSERTED");
	shell_print(sh, "temperature : %d.%d C (raw 0x%04x)", t10 / 10,
		    (t10 < 0 ? -t10 : t10) % 10, (uint16_t)temp_q8);
	shell_print(sh, "vcc         : %u.%04u V (raw 0x%04x)", vcc / 10000U, vcc % 10000U, vcc);
	shell_print(sh, "flags (0x08): 0x%02x  ctrl (0x1a): 0x%02x  page: 0x%02x", flags, ctrl,
		    page);
	shell_print(sh, "fault inject: %s", sensor_fault_injected() ? "on" : "off");
	return 0;
}

static void dump_region(const struct shell *sh, const uint8_t *src, unsigned int base)
{
	uint8_t copy[CMIS_PAGE_SIZE];
	k_spinlock_key_t key = k_spin_lock(&module_lock);

	memcpy(copy, src, sizeof(copy));
	k_spin_unlock(&module_lock, key);

	for (unsigned int off = 0; off < CMIS_PAGE_SIZE; off += 16U) {
		shell_hexdump_line(sh, base + off, &copy[off], 16);
	}
}

static int cmd_dump(const struct shell *sh, size_t argc, char **argv)
{
	const char *which = (argc > 1) ? argv[1] : "all";
	bool all = strcmp(which, "all") == 0;

	if (all || strcmp(which, "lower") == 0) {
		shell_print(sh, "lower memory (0x00-0x7f):");
		dump_region(sh, module_ctx.lower, 0x00);
	}
	if (all || strcmp(which, "p00") == 0) {
		shell_print(sh, "page 00h (0x80-0xff):");
		dump_region(sh, module_ctx.page00, 0x80);
	}
	if (all || strcmp(which, "p02") == 0) {
		shell_print(sh, "page 02h (0x80-0xff):");
		dump_region(sh, module_ctx.page02, 0x80);
	}
	return 0;
}

static int cmd_read(const struct shell *sh, size_t argc, char **argv)
{
	uint8_t addr;
	k_spinlock_key_t key;
	uint8_t val;

	ARG_UNUSED(argc);
	if (parse_u8(sh, argv[1], &addr) != 0) {
		return -EINVAL;
	}
	key = k_spin_lock(&module_lock);
	val = cmis_peek(&module_ctx, addr);
	k_spin_unlock(&module_lock, key);

	shell_print(sh, "0x%02x = 0x%02x", addr, val);
	return 0;
}

static int cmd_write(const struct shell *sh, size_t argc, char **argv)
{
	uint8_t addr;
	uint8_t val;

	ARG_UNUSED(argc);
	if (parse_u8(sh, argv[1], &addr) != 0 || parse_u8(sh, argv[2], &val) != 0) {
		return -EINVAL;
	}
	return host_write(sh, addr, val);
}

static int cmd_lowpwr(const struct shell *sh, size_t argc, char **argv)
{
	bool on;

	ARG_UNUSED(argc);
	if (parse_on_off(sh, argv[1], &on) != 0) {
		return -EINVAL;
	}
	return host_write(sh, CMIS_REG_MODULE_CTRL, on ? CMIS_CTRL_LOW_PWR_REQ : 0x00);
}

static int cmd_reset(const struct shell *sh, size_t argc, char **argv)
{
	ARG_UNUSED(argc);
	ARG_UNUSED(argv);
	return host_write(sh, CMIS_REG_MODULE_CTRL, CMIS_CTRL_SW_RESET);
}

static int cmd_fault(const struct shell *sh, size_t argc, char **argv)
{
	bool on;

	ARG_UNUSED(argc);
	if (parse_on_off(sh, argv[1], &on) != 0) {
		return -EINVAL;
	}
	sensor_inject_fault(on);
	shell_print(sh, "sensor fault injection %s", on ? "on" : "off");
	return 0;
}

SHELL_STATIC_SUBCMD_SET_CREATE(sub_cmis,
	SHELL_CMD_ARG(status, NULL, "Show state, monitors and flags", cmd_status, 1, 0),
	SHELL_CMD_ARG(dump, NULL, "Hex dump: dump [all|lower|p00|p02]", cmd_dump, 1, 1),
	SHELL_CMD_ARG(read, NULL, "Read byte (no side effects): read <addr>", cmd_read, 2, 0),
	SHELL_CMD_ARG(write, NULL, "Host-style write: write <addr> <val>", cmd_write, 3, 0),
	SHELL_CMD_ARG(lowpwr, NULL, "Request low power: lowpwr <on|off>", cmd_lowpwr, 2, 0),
	SHELL_CMD_ARG(reset, NULL, "Software reset via control register", cmd_reset, 1, 0),
	SHELL_CMD_ARG(fault, NULL, "Simulate sensor failure: fault <on|off>", cmd_fault, 2, 0),
	SHELL_SUBCMD_SET_END);

SHELL_CMD_REGISTER(cmis, &sub_cmis, "CMIS-lite module commands", NULL);
```
